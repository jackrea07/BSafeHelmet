## ESP32_PROJECTS/simple_ble_with_button_interrupt/main/Kconfig.projbuild
```kconfig
menu "BSafe Configuration"
    config I2S_LRCK_PIN
        int "I2S LRCK (WS) GPIO"
        default 22
        help
            GPIO number to use for I2S LRCK(WS) Driver.

    config I2S_BCK_PIN
        int "I2S BCK GPIO"
        default 3
        help
            GPIO number to use for I2S BCK Driver.

    config I2S_DATA_PIN
        int "I2S DATA GPIO"
        default 1
        help
            GPIO number to use for I2S Data Driver.

    config MAX_SDMODE
        int "MAX MODE GPIO"
        default 18
        help
            GPIO number for MAX chips
        
    config CRG_BUTTON
        int "CHARGE BUTTON INPUT"
        default 32
    
    config CRG_ADC
        int "ADC VBAT INPUT"
        default 39
        help
            GIPO number for VBAT input pin.
    config CRG_LED0
        int "CHARGE LED0 OUTPUT"
        default 33
        help 
            GPIO number for charge LED0 output, indicates charge > 25%
    
    config CRG_LED1
        int "CHARGE LED1 OUTPUT"
        default 25
        help 
            GPIO number for charge LED1 output, indicates charge > 50%
    
    config CRG_LED2
        int "CHARGE LED2 OUTPUT"
        default 26
        help 
            GPIO number for charge LED2 output, indicates charge > 75%
    
    config CRG_LED3
        int "CHARGE LED3 OUTPUT"
        default 27
        help 
            GPIO number for charge LED3 output, indicates charge at 100%
        
    config CRASH_INPUT
        int "CRASH INTERRUPT PIN"
        default 36
        help
            GPIO number to trigger crash interrupt
endmenu
```
